## mcu/bsp/luckfox_mini-M1-NONE/defconfig
```kconfig
CONFIG_SOC_RV1106=y
CONFIG_BOARD_RV1106_RISCV_EVB=y
CONFIG_RT_USING_CORE_RTTHREAD=y
CONFIG_RT_NAME_MAX=8
CONFIG_RT_ALIGN_SIZE=4
CONFIG_RT_THREAD_PRIORITY_32=y
CONFIG_RT_THREAD_PRIORITY_MAX=32
CONFIG_RT_TICK_PER_SECOND=1000
CONFIG_RT_USING_OVERFLOW_CHECK=y
CONFIG_RT_USING_HOOK=y
CONFIG_RT_USING_IDLE_HOOK=y
CONFIG_RT_IDEL_HOOK_LIST_SIZE=4
CONFIG_IDLE_THREAD_STACK_SIZE=1024
CONFIG_RT_USING_SEMAPHORE=y
CONFIG_RT_USING_MUTEX=y
CONFIG_RT_USING_EVENT=y
CONFIG_RT_USING_MAILBOX=y
CONFIG_RT_USING_MESSAGEQUEUE=y
CONFIG_RT_USING_MEMPOOL=y
CONFIG_RT_USING_SMALL_MEM=y
CONFIG_RT_USING_HEAP=y
CONFIG_RT_USING_DEVICE=y
CONFIG_RT_USING_CONSOLE=y
CONFIG_RT_CONSOLEBUF_SIZE=128
CONFIG_RT_CONSOLE_DEVICE_NAME="uart2"
CONFIG_RT_VER_NUM=0x30103
CONFIG_ARCH_RISCV=y
CONFIG_RT_USING_COMPONENTS_INIT=y
CONFIG_RT_USING_DEVICE_IPC=y
CONFIG_RT_PIPE_BUFSZ=512
CONFIG_RT_USING_SERIAL=y
CONFIG_RT_SERIAL_RB_BUFSZ=64
CONFIG_RT_USING_PIN=y
CONFIG_RT_USING_LIBC=y
CONFIG_RT_BOARD_NAME="luckfox_mini-M1-NONE"
CONFIG_RT_USING_CACHE=y
CONFIG_RT_USING_PSTORE=y
CONFIG_PERSISTENT_RAM_ADDR=0x183c000
CONFIG_PERSISTENT_RAM_SIZE=0x3000
```
